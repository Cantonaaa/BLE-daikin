## ESP/main/Kconfig
```kconfig
menu "Daikin BLE Configuration"

    config ESP_WIFI_SSID
        string "WiFi SSID"
        default "myssid"

    config ESP_WIFI_PASSWORD
        string "WiFi Password"
        default "mypassword"

endmenu
```

## ESP/sdkconfig.defaults
```kconfig
CONFIG_IDF_TARGET="esp32s3"
CONFIG_IDF_TARGET_ESP32S3=y
CONFIG_ESPTOOLPY_FLASHSIZE_16MB=y
CONFIG_PARTITION_TABLE_CUSTOM=y
CONFIG_PARTITION_TABLE_CUSTOM_FILENAME="partitions_16m.csv"
CONFIG_SPIRAM_MODE_OCT=y
CONFIG_SPIRAM_TYPE_ESPPSRAM64=y
CONFIG_SPIRAM=y
CONFIG_BT_ENABLED=y
CONFIG_BT_NIMBLE_ENABLED=y
CONFIG_ESP_WIFI_ENABLED=y
CONFIG_LWIP_ENABLE=y

# Disable WiFi+BT coexistence to avoid missing binary lib
CONFIG_ESP_COEX_ENABLED=n
CONFIG_ESP_COEX_SW_COEXIST_ENABLE=n
```
